## sound/soc/bcm2708/Kconfig
```kconfig
config SND_BCM2708_SOC_I2S
	tristate

config SND_BCM2708_SOC
	tristate "SoC Audio support for the Broadcom BCM2708 I2S module"
	depends on MACH_BCM2708
	select SND_SOC_DMAENGINE_PCM
	select SND_SOC_GENERIC_DMAENGINE_PCM
	help
	  Say Y or M if you want to add support for codecs attached to
	  the BCM2708 I2S interface. You will also need
	  to select the audio interfaces to support below.

config SND_BCM2708_SOC_RPI_CODEC_MBED
	tristate "AudioCODEC for mbed (TLV320AIC32B)"
	depends on SND_BCM2708_SOC
	select SND_BCM2708_SOC_I2S
	select SND_SOC_TLV320AIC3X
	help
	  Say Y if you want to add support for AudioCODEC for mbed (TLV320AIC32B)
```
